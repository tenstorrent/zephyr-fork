## dts/bindings/mspi/snps,designware-ssi.yaml
```yaml
# Copyright (c) 2024 Nordic Semiconductor ASA
# SPDX-License-Identifier: Apache-2.0

description: Synopsys DesignWare Synchronous Serial Interface (SSI) node

compatible: "snps,designware-ssi"

include: [mspi-controller.yaml, pinctrl-device.yaml]

properties:
  reg:
    required: true

  interrupts:
    required: true

  packet-data-limit:
    required: true
    const: 65536

  aux-reg-enable:
    type: boolean
    description: |
      Activates auxiliary register access that is needed on some platforms.

  memmap-write-support:
    type: boolean
    description: |
      Set when the DW SSI core is synthesized with SSIC_XIP_WRITE_REG_EN, i.e.
      when the XIP-write register block at core offsets 0x140/0x144/0x148
      (xip_write_incr_inst, xip_write_wrap_inst, xip_write_ctrl) is present.

  concurrent-memmap-support:
    type: boolean
    description: |
      Set when the DW SSI core is synthesized with SSIC_CONCURRENT_XIP_EN,
      i.e. when master (non-memory-mapped) transfers can be issued while the
      memory-mapped aperture is enabled. This property will enable the XIPSER
      register which is needed by devices with this configuration.

  fifo-depth:
    required: true
    type: int
    min: 8
    max: 256
    description: |
      Number of items that can be stored in the TX FIFO.
      If the RX FIFO depth is not specified separately in the rx-fifo-depth
      property, this value specifies depth of both TX and RX FIFOs.

  rx-fifo-depth:
    type: int
    min: 8
    max: 256
    description: |
      Number of items that can be stored in the RX FIFO.

  fifo-bound-transfers:
    type: boolean
    description: |
      Set for a core that has neither a transfer start FIFO level
      (TXFTLR.TXFTHR) nor clock stretching. Such a core ends the transfer,
      deasserting the slave select line, as soon as its TX FIFO runs empty,
      so refilling the FIFO during a transfer is a race against the serial
      clock that cannot be won reliably.

      With this property, every packet must fit in the FIFOs: all of its TX
      FIFO entries are written before the transfer is started, and all of
      its received frames fit in the RX FIFO. Packets that do not fit are
      rejected, and asynchronous and DMA transfers are not supported.

  tx-fifo-threshold:
    type: int
    min: 0
    max: 255
    description: |
      Number of entries in the TX FIFO above which the TX transfer is started.
      Must be below the TX FIFO depth.

  rx-fifo-threshold:
    type: int
    min: 0
    max: 255
    description: |
      Number of entries in the RX FIFO above which the controller gets an RX
      interrupt. Must be below the RX FIFO depth.

  dma-transmit-data-level:
    type: int
    min: 0
    max: 255
    description: |
      When in DMA mode, the transmit data level field controls the level at which a DMA request
      is made by the transmit logic. A request to transmit is generated when the number of
      valid data entries in the transmit FIFO is equal to or below this field value. Lower values
      mean less frequent DMA triggers with larger bursts. Higher values mean fewer, smaller bursts
      (lower latency, higher overhead). Must be below the TX FIFO depth.

  dma-receive-data-level:
    type: int
    min: 0
    max: 255
    description: |
      When in DMA mode, the receive data level field controls the level at which a DMA request
      is made by the receive logic. A request to receive is generated when the number of
      valid data entries in the receive FIFO is greater than this value. Lower values mean
      more frequent DMA triggers and higher values mean larger less frequent bursts.
      Must be below the RX FIFO depth.
```
